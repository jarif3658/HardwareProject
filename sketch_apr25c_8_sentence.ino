#include <Wire.h>
#include <Adafruit_GFX.h>
#include <Adafruit_SH110X.h>
#include <SoftwareSerial.h>

// --- OLED setup ---
#define SCREEN_WIDTH 128
#define SCREEN_HEIGHT 64
Adafruit_SH1106G display(SCREEN_WIDTH, SCREEN_HEIGHT, &Wire, -1);

// --- MP3 module setup (DFPlayer) ---
SoftwareSerial mp3Serial(10, 11); // RX, TX

// --- Bluetooth using hardware UART ---
#define BT Serial  // HC-05 connected to D0/D1

// --- Flex sensor pins ---
const int flexPin1 = A1; // I need water
const int flexPin2 = A0; // Thank you
const int flexPin3 = A3; // Hello
const int flexPin4 = A6; // I need food
const int flexPin5 = A2; // Please help me

// --- Thresholds ---
const int TH1 = 800;
const int TH2 = 800;
const int TH3 = 850;
const int TH4 = 800;
const int TH5 = 800;

// Bitmap sizes
#define BMP_W 100
#define BMP_H 24

// -------------------------------------------------------------------
// PASTE YOUR EXISTING BITMAP ARRAYS HERE EXACTLY AS THEY ARE:
// waterBitmap
// thankYouBitmap
// helloBitmap
// foodBitmap
// helpBitmap
// -------------------------------------------------------------------

const uint8_t waterBitmap[] PROGMEM = {
0x00, 0x00, 0x00, 0x00, 0x00, 0x00, 0x00, 0x00, 0x00, 0x00, 0x00, 0x00, 0x00,
0x00, 0x00, 0x00,
0x00, 0x00, 0x00, 0x02, 0x00, 0x00, 0x00, 0x00, 0x00, 0x00, 0x00, 0x00, 0x00,
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0x00, 0x00, 0x00
};

const uint8_t thankYouBitmap[] PROGMEM = {
0x00, 0x00, 0x00, 0x00, 0x00, 0x00, 0x00, 0x00, 0x00, 0x00, 0x00, 0x00, 0x00,
0x00, 0x00, 0x00,
0x00, 0x00, 0x00, 0x00, 0x00, 0x00, 0x00, 0x00, 0x00, 0x00, 0x00, 0x00, 0x00,
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0x00, 0x00, 0x00
};

const uint8_t helloBitmap[] PROGMEM = {
0x00, 0x00, 0x00, 0x00, 0x00, 0x00, 0x00, 0x00, 0x00, 0x00, 0x00, 0x00, 0x00,
0x00, 0x00, 0x00,
0x00, 0x00, 0x00, 0x00, 0x00, 0x00, 0x00, 0x00, 0x00, 0x00, 0x00, 0x00, 0x00,
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0x00, 0x00, 0x00
};

const uint8_t foodBitmap[] PROGMEM = {
0x00, 0x00, 0x00, 0x00, 0x00, 0x00, 0x00, 0x00, 0x00, 0x00, 0x00, 0x00, 0x00,
0x00, 0x00, 0x00,
0x00, 0x00, 0x00, 0x00, 0x00, 0x00, 0x00, 0x00, 0x00, 0x00, 0x00, 0x00, 0x00,
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0x00, 0x00, 0x00
};

const uint8_t helpBitmap[] PROGMEM = {
0x00, 0x00, 0x00, 0x00, 0x00, 0x00, 0x00, 0x00, 0x00, 0x00, 0x00, 0x00, 0x00,
0x00, 0x00, 0x00,
0x00, 0x00, 0x00, 0x00, 0x00, 0x00, 0x00, 0x00, 0x00, 0x00, 0x00, 0x00, 0x00,
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0x00, 0x00, 0x00
};

const uint8_t fineBitmap[] PROGMEM = {
0x00, 0x00, 0x00, 0x00, 0x00, 0x00, 0x00, 0x00, 0x00, 0x00, 0x00, 0x00, 0x00, 0x00, 0x00, 0x0e, 
	0x00, 0x00, 0x00, 0x00, 0x00, 0x00, 0x00, 0x00, 0x30, 0x00, 0x00, 0x00, 0x1f, 0x80, 0x00, 0x00, 
	0x00, 0x00, 0x00, 0x00, 0x00, 0xfc, 0x00, 0x00, 0x00, 0x3f, 0xc0, 0x00, 0x00, 0x00, 0x00, 0x00, 
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	0x00, 0x00, 0x10, 0x00, 0x00, 0x00, 0x00, 0x00, 0x00, 0x00, 0x00, 0x00, 0x00, 0x00, 0x00, 0x00
};

const uint8_t happyBitmap[] PROGMEM = { 
  0x00, 0x00, 0x00, 0x00, 0x0f, 0x00, 0x00, 0x00, 0x00, 0x00, 0x3c, 0x00, 0x00, 0x00, 0x00, 0x00, 
	0x00, 0x7f, 0xf0, 0x00, 0x00, 0x00, 0x01, 0xff, 0xc0, 0x00, 0x00, 0x00, 0x00, 0x00, 0xff, 0xfc, 
	0x00, 0x00, 0x00, 0x03, 0xff, 0xf0, 0x00, 0x00, 0x00, 0x00, 0x01, 0xf8, 0xfe, 0x00, 0x00, 0x00, 
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	0x00, 0x00, 0x00, 0x00, 0x00, 0x00, 0x00, 0x00, 0x00, 0x00, 0x00, 0x3e, 0x08, 0x00, 0x00, 0x00
};

const uint8_t notWellBitmap[] PROGMEM = {
0x00, 0x00, 0x00, 0x00, 0x00, 0x00, 0x00, 0x00, 0x00, 0x00, 0x00, 0x00, 0x00, 0x00, 0x00, 0x00, 
	0x00, 0x00, 0x00, 0x00, 0x00, 0x00, 0x00, 0x00, 0x00, 0x00, 0x00, 0x00, 0x00, 0x00, 0x00, 0x00, 
	0x00, 0x00, 0x00, 0x00, 0x00, 0x00, 0x00, 0x00, 0x00, 0x00, 0x00, 0x00, 0x00, 0x00, 0x00, 0x00, 
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	0x00, 0x60, 0x00, 0x00, 0x00, 0x00, 0x00, 0x00, 0x00, 0x00, 0x00, 0x00, 0x00, 0x00, 0x00, 0x00
};
// -------------------------------------------------------------------

// MP3 command function
void sendMP3Command(byte command, byte param1, byte param2) {
  byte buf[10] = {0x7E, 0xFF, 0x06, command, 0x00, param1, param2, 0xEF};
  for (int i = 0; i < 8; i++) {
    mp3Serial.write(buf[i]);
  }
}

// Display English + Bangla function
void showMessage(const char* englishText, const uint8_t* banglaBmp, int bmpW, int bmpH) {
  display.clearDisplay();
  display.setTextSize(1);
  display.setTextColor(SH110X_WHITE);

  int16_t x1, y1;
  uint16_t w, h;
  display.getTextBounds(englishText, 0, 0, &x1, &y1, &w, &h);

  int enX = (SCREEN_WIDTH - w) / 2;
  display.setCursor(enX, 0);
  display.print(englishText);

  int bmpX = (SCREEN_WIDTH - bmpW) / 2;
  int bmpY = 22;
  display.drawBitmap(bmpX, bmpY, banglaBmp, bmpW, bmpH, SH110X_WHITE);

  display.display();
}

// Display English only
void showEnglishOnly(const char* text) {
  display.clearDisplay();
  display.setTextSize(1);
  display.setTextColor(SH110X_WHITE);

  int16_t x1, y1;
  uint16_t w, h;
  display.getTextBounds(text, 0, 0, &x1, &y1, &w, &h);

  int textX = (SCREEN_WIDTH - w) / 2;
  display.setCursor(textX, 20);
  display.print(text);
  display.display();
}

// Display phone messages
void showPhoneMessage(const String &msg) {
  display.clearDisplay();
  display.setTextSize(1);
  display.setTextColor(SH110X_WHITE);

  display.setCursor(0, 0);
  display.print("Phone:");

  int16_t x1, y1;
  uint16_t w, h;
  display.getTextBounds(msg.c_str(), 0, 0, &x1, &y1, &w, &h);

  int msgX = (SCREEN_WIDTH - w) / 2;
  display.setCursor(msgX, 20);
  display.print(msg);
  display.display();
}

void setup() {
  Serial.begin(9600);     // Bluetooth on D0/D1
  mp3Serial.begin(9600);  // DFPlayer on D10/D11

  Wire.begin();
  if (!display.begin(0x3C, true)) {
    while (1);
  }

  display.clearDisplay();
  display.setTextSize(1);
  display.setTextColor(SH110X_WHITE);
  display.setCursor(20, 25);
  display.print("System Ready");
  display.display();
  delay(1000);
}

void loop() {
  // --- Check Bluetooth first ---
  if (BT.available()) {
    String msg = "";
    while (BT.available()) {
      char c = BT.read();
      if (c != '\n' && c != '\r') {
        msg += c;
      }
    }

    if (msg.length() > 0) {
      showPhoneMessage(msg);
      delay(2000);
    }
  }

  // --- Read flex sensors ---
  int v1 = analogRead(flexPin1);
  int v2 = analogRead(flexPin2);
  int v3 = analogRead(flexPin3);
  int v4 = analogRead(flexPin4);
  int v5 = analogRead(flexPin5);

  bool f1 = (v1 > TH1);
  bool f2 = (v2 > TH2);
  bool f3 = (v3 > TH3);
  bool f4 = (v4 > TH4);
  bool f5 = (v5 > TH5);

  // --- COMBINATION checks first ---
  if (f1 && f2) {
    showMessage("I am fine", fineBitmap, BMP_W, BMP_H);
    BT.println("I am fine");
    sendMP3Command(0x03, 0x00, 7);
    delay(1000);
  }
  else if (f1 && f3) {
    showMessage("I am happy", happyBitmap, BMP_W, BMP_H);
    BT.println("I am happy");
    sendMP3Command(0x03, 0x00, 6);
    delay(1000);
  }
  else if (f1 && f4) {   // A1 + A6
    showMessage("I am not feeling well", notWellBitmap, BMP_W, BMP_H);
    BT.println("I am not feeling well");
    sendMP3Command(0x03, 0x00, 8);
    delay(1000);
  }

  // --- Single sensor checks ---
  else if (f1) {
    showMessage("I need water", waterBitmap, BMP_W, BMP_H);
    BT.println("I need water");
    sendMP3Command(0x03, 0x00, 1);
    delay(1000);
  }
  else if (f2) {
    showMessage("Thank you", thankYouBitmap, BMP_W, BMP_H);
    BT.println("Thank you");
    sendMP3Command(0x03, 0x00, 2);
    delay(1000);
  }
  else if (f3) {
    showMessage("Hello", helloBitmap, BMP_W, BMP_H);
    BT.println("Hello");
    sendMP3Command(0x03, 0x00, 4);
    delay(1000);
  }
  else if (f4) {
    showMessage("I need food", foodBitmap, BMP_W, BMP_H);
    BT.println("I need food");
    sendMP3Command(0x03, 0x00, 5);
    delay(1000);
  }
  else if (f5) {
    showMessage("Please help me", helpBitmap, BMP_W, BMP_H);
    BT.println("Please help me");
    sendMP3Command(0x03, 0x00, 3);
    delay(1000);
  }

  delay(300);
}
